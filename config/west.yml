## config/west.yml
```yaml
manifest:
  defaults:
    revision: e4fb39d4a6514fe90d44b1570f908bddc5df0ad2  # Exemplo: commit fixo do ZMK main com Studio (substitui pelo commit/tag que preferires)

  remotes:
    - name: zmkfirmware
      url-base: https://github.com/zmkfirmware

  projects:
    - name: zmk
      remote: zmkfirmware
      import: app/west.yml

  self:
    path: config
```
